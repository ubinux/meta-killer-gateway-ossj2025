## conf/distro/killer-gateway.conf
```bitbake
# conf/distro/killer-gateway.conf
DISTRO = "killer-gateway"
DISTRO_NAME = "Killer Gateway Distro"
DISTRO_VERSION = "1.0"

# Systemd (distro-level feature + runtime selection)
DISTRO_FEATURES:append = " systemd usrmerge"
VIRTUAL-RUNTIME_init_manager = "systemd"

# Language defaults
IMAGE_LINGUAS ?= "en-us"
```

## conf/layer.conf
```bitbake
# ============================================================
# meta-killer-gateway layer configuration
# ============================================================
# Search paths
BBPATH .= ":${LAYERDIR}"
BBFILES += "${LAYERDIR}/recipes-*/*/*.bb \
            ${LAYERDIR}/recipes-*/*/*.bbappend"

# (Optional) If you keep shared files/classes:
# FILESEXTRAPATHS:prepend := "${LAYERDIR}/files:"

# Collection settings (underscore form is correct here)
BBFILE_COLLECTIONS += "killer-gateway"
BBFILE_PATTERN_killer-gateway := "^${LAYERDIR}/"
BBFILE_PRIORITY_killer-gateway = "7"

# Dependencies (use colon overrides on modern Yocto)
LAYERDEPENDS_killer-gateway = "core"

# Supported Yocto releases (list only what you test)
LAYERSERIES_COMPAT_killer-gateway = "styhead"
```
